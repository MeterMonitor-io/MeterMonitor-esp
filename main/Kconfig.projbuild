## main/Kconfig.projbuild
```kconfig
menu "MeterMonitor config"

    choice METER_MONITOR_BOARD
        bool "ESP32-Board to be used"
        default METER_MONITOR_BOARD_ESP32_CAM
        help
            MeterMonitor is tested on more than one ESP32-Board, that need different settings. Select the board, that is to be used.

	config METER_MONITOR_BOARD_ESP32_CAM
		bool "AiThinker ESP32-Cam"
	config METER_MONITOR_BOARD_SEEED_XIAO_ESP32S3_SENSE
		bool "Seeed Studio XIAO ESP32S3 Sense"
    endchoice

	config METER_MONITOR_SLEEP_TIME
		int "The picture capture interval (in min.)"
		range 1 1440
		default 5
		help
			The interval in which a picture is to be captured in minutes. Value must be between 5 and 1440 Minutes (24 hours). Defaults to every 5 minutes.

    config METER_MONITOR_NAME
        string "Unique Identifying meter name"
        default "UndefinedMeter"
        help
            The name of the meter, this camera will track. It is used for identification at the classifier and as a MQTT-Topic.

    config METER_MONITOR_WIFI_SSID
        string "WiFi SSID"
        default "myssid"
        help
            SSID (network name) to connect to.

    config METER_MONITOR_WIFI_PASSWORD
        string "WiFi Password"
        default "mypassword"
        help
            WiFi password to use.

    config METER_MONITOR_WIFI_MAXIMUM_RETRY
        int "WiFi maximum retries"
        default 5
        help
            Set the Maximum retry to avoid station reconnecting to the AP unlimited when the AP is really inexistent.

    config METER_MONITOR_SNTP_TIME_SERVER
        string "SNTP server name"
        default "pool.ntp.org"
        help
            Hostname of the SNTP server to be used for time synchronisation.

    config METER_MONITOR_SNTP_TIME_SYNC_ALWAYS
        bool "Sync time at every boot"
        default "y"
        help
            Timekeeping of the ESP is not very accurate in deep sleep. To prevent very serious clock drift, the time can be synced at every boot.

    config METER_MONITOR_MQTT_URI
        string "URI of the MQTT-Broker"
        default "mqtt://mqtt.eclipseprojects.io"
        help
            URI of the Broker, to which pictures should be send

    config METER_MONITOR_MQTT_PORT
        int "MQTT-Broker Port"
        default 1883
        help
            Port to connect on to the MQTT-Broker

    config METER_MONITOR_MQTT_TOPIC_BASE
        string "MQTT-Topic for publishing"
        default "MeterMonitor/"
        help
            Topic, to which the data will be send to. It needs to end with '/', because the METER_MONITOR_NAME is appended after this.

    config METER_MONITOR_MQTT_USERNAME
        string "Username (if credentials needed)"
        help
            Username of the credentials, if needed. If not defined no authentication is needed.

    config METER_MONITOR_MQTT_USERNAME_DEFINED
        bool
        default "y" if METER_MONITOR_MQTT_USERNAME != ""
        depends on METER_MONITOR_MQTT_USERNAME != ""
        help
            This option is automatically set if a username is defined.

    config METER_MONITOR_MQTT_PASSWORD
        string "Password (if credentials needed)"
        help
            Password of the credentials, if needed. If not defined no authentication is needed.

    config METER_MONITOR_MQTT_PASSWORD_DEFINED
        bool
        default "y" if METER_MONITOR_MQTT_PASSWORD != ""
        depends on METER_MONITOR_MQTT_PASSWORD != ""
        help
            This option is automatically set if a password is defined.

	config METER_MONITOR_DONE
		bool "Send DONE-Signal?"
		default "y"
		help
			Send DONE-signal for the TPL5110-Module?

	config METER_MONITOR_DONE_GPIO
		int "Done - GPIO"
		default 2
		range 0 39
		depends on METER_MONITOR_DONE
		help
			Select the GPIO pin that is set high to turn off power supply via TPL5110. Default for Seeed Studio XIAO ESP32S3 Sense is GPIO 9.

	config METER_MONITOR_FLASH
		bool "Flash - Light?"
		default "n"
		help
			Use the build in flash to light up the meter?

	config METER_MONITOR_FLASH_GPIO
		int "Flash - GPIO"
		default 4
		range 0 39
		depends on METER_MONITOR_FLASH
		help
			Select the GPIO pin that the board uses for the internal flash. Default for ESP32-Cam is GPIO 4. Default for Seeed Studio XIAO ESP32S3 Sense is GPIO 21.

	config METER_MONITOR_LED_STRIP
		bool "LED-Strip - Light?"
		default "n"
		help
			Use an external LED-Strip to light up the meter?

	config METER_MONITOR_LED_STRIP_GPIO
		int "LED-Strip - GPIO"
		default 12
		range 0 39
		depends on METER_MONITOR_LED_STRIP
		help
			Select the GPIO pin that is used for the LED-Strip.

	config METER_MONITOR_LED_STRIP_LED_COUNT
		int "LED-Strip - LED Count"
		default 9
		range 1 100
		depends on METER_MONITOR_LED_STRIP
		help
			The number of LEDs, that are supposed to be addressed and lit up.

	config METER_MONITOR_LED_STRIP_R
		int "LED-Strip - Red"
		range 0 255
		default 50
		depends on METER_MONITOR_LED_STRIP
		help
			The Red-component of the light, the LED-Strip should light up

	config METER_MONITOR_LED_STRIP_G
		int "LED-Strip - Green"
		range 0 255
		default 50
		depends on METER_MONITOR_LED_STRIP
		help
			The Green-component of the light, the LED-Strip should light up

	config METER_MONITOR_LED_STRIP_B
		int "LED-Strip - Blue"
		range 0 255
		default 50
		depends on METER_MONITOR_LED_STRIP
		help
			The Blue-component of the light, the LED-Strip should light up


    choice METER_MONITOR_CAMERA_FRAME_SIZE
        bool "Camera Frame Size"
        default METER_MONITOR_CAMERA_FRAME_SIZE_VGA
        help
            Select the frame size for the camera. Options are defined in the esp32-camera library.

	config METER_MONITOR_CAMERA_FRAME_SIZE_QQVGA
		bool "160x120 (QQVGA)"
	config METER_MONITOR_CAMERA_FRAME_SIZE_QVGA
		bool "320x240 (QVGA)"
	config METER_MONITOR_CAMERA_FRAME_SIZE_VGA
		bool "640x480 (VGA)"
	config METER_MONITOR_CAMERA_FRAME_SIZE_SVGA
		bool "800x600 (SVGA)"
	config METER_MONITOR_CAMERA_FRAME_SIZE_XGA
		bool "1024x768 (XGA)"
	config METER_MONITOR_CAMERA_FRAME_SIZE_SXGA
		bool "1280x1024 (SXGA)"
	config METER_MONITOR_CAMERA_FRAME_SIZE_UXGA
		bool "1600x1200 (UXGA)"
    endchoice

endmenu
```

## sdkconfig.defaults
```kconfig
################################################
# 			Generelle Konfiguration
################################################

CONFIG_SPIRAM=n
CONFIG_ESPTOOLPY_FLASHFREQ_80M=y
CONFIG_ESPTOOLPY_FLASHMODE_QIO=y
CONFIG_ESPTOOLPY_FLASHSIZE_4MB=y
CONFIG_FREERTOS_UNICORE=y
CONFIG_BOOTLOADER_LOG_LEVEL_WARN=y
CONFIG_PARTITION_TABLE_SINGLE_APP_LARGE=y
CONFIG_ESP_DEFAULT_CPU_FREQ_MHZ_80=y
CONFIG_ESP_DEFAULT_CPU_FREQ_MHZ=80
CONFIG_FATFS_LFN_HEAP=y

################################################
#    Applikationsspezifische Konfigurationen
################################################
```
